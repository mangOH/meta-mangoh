## conf/layer.conf
```bitbake
# mangOH specific variables go here
BBPATH .= ":${LAYERDIR}"

# We have a recipes directory, add to BBFILES
BBFILES += "${LAYERDIR}/recipes-*/*/*.bb \
            ${LAYERDIR}/recipes-*/*/*.bbappend"

BBFILE_COLLECTIONS += "mangoh"
BBFILE_PATTERN_mangoh := "^${LAYERDIR}/"
BBFILE_PRIORITY_mangoh = "40"
```
